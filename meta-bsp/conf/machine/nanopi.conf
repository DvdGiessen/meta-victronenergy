## meta-bsp/conf/machine/nanopi.conf
```bitbake
#@TYPE: Machine
#@NAME: NanoPi Duo
#@DESCRIPTION: FriendlyARM NanoPi board

SOC_FAMILY = "sun8i"
include conf/machine/include/soc-family.inc

DEFAULTTUNE = "cortexa7hf-neon-vfpv4"

require conf/machine/include/tune-cortexa7.inc

MACHINE_FEATURES ?= "apm alsa usbgadget usbhost vfat rtc serial wifi sdio headless"
PACKAGECONFIG_append_pn-qtbase = " no-opengl"
SERIAL_CONSOLE ?= "-l;/sbin/autologin;-n;115200;ttyS0"
USE_VT = "0"

# Inputs for machine-conf-runtime recipe
VE_MKX_PORT = "/dev/ttyS3"
VE_VEDIRECT_PORTS = "/dev/ttyS1"
VE_RELAYS = ""
VE_CAN_PORTS = "can0"

IMAGE_FSTYPES ?= "nanopi-sdimg.zip"

# config of u-boot to be used
UBOOT_MACHINE = "nanopi_easysolar-display_defconfig"
UBOOT_ENTRYPOINT ?= "0x40008000"
UBOOT_LOADADDRESS ?= "0x400080OB00"
UBOOT_SUFFIX = "bin"
UBOOT_LOCALVERSION = "-g${@d.getVar('SRCPV', True).partition('+')[2][0:7]}"

# Kernel name
SDIMG_KERNELIMAGE ?= "kernel7.img"

KERNEL_IMAGETYPE ?= "zImage"
IMAGE_BOOT_FILES ?= "boot/*"

# Note that this variable only affects images based on packagegroup-base, which
# does not include the core-image-minimal or core-image-full-cmdline images.
MACHINE_EXTRA_RDEPENDS += "kernel-modules kernel-image"

PREFERRED_PROVIDER_virtual/kernel ?= "linux-nanopi"
PREFERRED_PROVIDER_virtual/bootloader = "u-boot-nanopi"
PREFERRED_VERSION_u-boot-nanopi ?= "v2017.09%"

# Kernel Version
PREFERRED_VERSION_linux-nanopi ?= "4.13%"

KERNEL_DEVICE_BLOBS = " \
	nanopi_easysolar-display.dtb \
"

KERNEL_DEVICE_OVERLAYS = " \
"

KERNEL_DEVICETREE ?= "${KERNEL_DEVICE_BLOBS} ${KERNEL_DEVICE_OVERLAYS}"

IMAGE_CLASSES += "sdcard_image-nanopi"
```

## meta-bsp/recipes-bsp/u-boot/u-boot-nanopi/git/configs/nanopi_easysolar-display_defconfig
```kconfig
CONFIG_ARM=y
CONFIG_ARCH_SUNXI=y
CONFIG_MACH_SUN8I_H3=y
CONFIG_DRAM_CLK=408
CONFIG_DRAM_ZQ=3881979
CONFIG_DRAM_ODT_EN=y
# CONFIG_VIDEO_DE2 is not set
CONFIG_DEFAULT_DEVICE_TREE="nanopi_easysolar-display"
# CONFIG_SYS_MALLOC_CLEAR_ON_INIT is not set
CONFIG_SD_BOOT=y
CONFIG_CONSOLE_MUX=y
CONFIG_SPL=y
# CONFIG_CMD_IMLS is not set
# CONFIG_CMD_FLASH is not set
# CONFIG_CMD_FPGA is not set
# CONFIG_SPL_DOS_PARTITION is not set
# CONFIG_SPL_ISO_PARTITION is not set
# CONFIG_SPL_EFI_PARTITION is not set
CONFIG_ENV_IS_IN_FAT=y
CONFIG_ENV_FAT_INTERFACE="mmc"
CONFIG_ENV_FAT_DEVICE_AND_PART="0:1"
CONFIG_ENV_OFFSET=0x0
CONFIG_ENV_SIZE=0x4000
CONFIG_NET_RANDOM_ETHADDR=y
CONFIG_SUN8I_EMAC=y
CONFIG_USB_EHCI_HCD=y
CONFIG_SYS_USB_EVENT_POLL_VIA_INT_QUEUE=y
```
